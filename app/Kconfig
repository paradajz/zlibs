## module/Kconfig
```kconfig
menu "zlibs"

menuconfig ZLIBS_TESTING
    bool "Testing mode"
    default n
    help
      Enable zlibs test-only behavior.

      This is used by unit tests reliant on hardware functionality not
      normally available on native_sim board. Should not be used in
      the application.

config ZLIBS_INTERNAL_WORKQUEUE_PRIORITY
    int "Internal workqueue priority"
    default 0
    help
      Zephyr priority used by the shared zlibs workqueue thread.

      Lower numeric values correspond to higher priority in Zephyr.

config ZLIBS_INTERNAL_WORKQUEUE_STACK_SIZE
    int "Internal workqueue stack size"
    default 1024
    help
      Stack size, in bytes, for the shared zlibs workqueue thread.

      Increase this if work items scheduled by zlibs utilities require more
      stack space.

rsource "src/Kconfig"

module = ZLIBS
module-str = zlibs
source "subsys/logging/Kconfig.template.log_config"

endmenu
```

## module/src/drivers/Kconfig
```kconfig
rsource "uart_hw/Kconfig"
rsource "uart_mock/Kconfig"
rsource "usb_hw/Kconfig"
rsource "usb_mock/Kconfig"
```

## module/src/drivers/uart_hw/Kconfig
```kconfig
menuconfig ZLIBS_DRIVERS_UART_HW
    bool "UART hardware wrapper"
    default n
    select SERIAL
    select RING_BUFFER
    select UART_USE_RUNTIME_CONFIGURE
    select UART_INTERRUPT_DRIVEN if !ZLIBS_TESTING
    help
      Enable the hardware-backed UART implementation in zlibs.

      This wrapper configures a Zephyr UART device, uses ring buffers for
      transmit and receive data, and uses interrupt-driven UART.
```

## module/src/drivers/uart_mock/Kconfig
```kconfig
menuconfig ZLIBS_DRIVERS_UART_MOCK
    bool "UART mock"
    default n
    help
      Enable the GoogleMock-based UART implementation used by tests.

      This provides mocked UART implementation as a drop-in replacement
      for the hardware UART wrapper when no real device is involved.
```

## module/src/drivers/usb_hw/Kconfig
```kconfig
menuconfig ZLIBS_DRIVERS_USB_HW
    bool "USB hardware wrapper"
    default n
    select USB_DEVICE_STACK_NEXT
    help
      Enable the hardware-backed USB implementation in zlibs.

      This wrapper configures the Zephyr USB device stack and exposes
      the common USB functionality through the zlibs USB driver API.

menu "USB wrapper options"
    depends on ZLIBS_DRIVERS_USB_HW

config ZLIBS_DRIVERS_USB_MANUFACTURER
    string "USB device manufacturer string"
    default "Zephyr Project"
    help
      USB device manufacturer string.

config ZLIBS_DRIVERS_USB_PRODUCT
    string "USB device product string"
    default "USB sample"
    help
      USB device product string.

config ZLIBS_DRIVERS_USB_VID
    hex "USB device Vendor ID"
    default 0x2fe3
    help
      USB device Vendor ID.

config ZLIBS_DRIVERS_USB_PID
    hex "USB device Product ID"
    default 0x0001
    help
      USB device Product ID.

config ZLIBS_DRIVERS_USB_SELF_POWERED
    bool "USB device Self-powered attribute"
    default y
    help
      Set the Self-powered attribute in the USB configuration.

config ZLIBS_DRIVERS_USB_REMOTE_WAKEUP
    bool "USB device Remote Wakeup attribute"
    help
      Set the Remote Wakeup attribute in the USB configuration.

config ZLIBS_DRIVERS_USB_MAX_POWER
    int "USB device bMaxPower value"
    default 125
    range 0 250
    help
      bMaxPower value in the USB configuration in 2 mA units.

endmenu
```

## module/src/drivers/usb_mock/Kconfig
```kconfig
menuconfig ZLIBS_DRIVERS_USB_MOCK
    bool "USB mock"
    default n
    help
      Enable the GoogleMock-based USB implementation used by tests.

      This provides a mocked USB implementation as a drop-in replacement
      for the hardware USB wrapper when no real device is involved.
```

## module/src/utils/Kconfig
```kconfig
rsource "emueeprom/Kconfig"
rsource "filters/Kconfig"
rsource "lessdb/Kconfig"
rsource "midi/Kconfig"
rsource "misc/Kconfig"
rsource "motor_control/Kconfig"
rsource "settings/Kconfig"
rsource "signaling/Kconfig"
rsource "state_machine/Kconfig"
rsource "sysex_conf/Kconfig"
rsource "threads/Kconfig"
```

## module/src/utils/filters/Kconfig
```kconfig
menuconfig ZLIBS_UTILS_FILTERS
    bool "Filters"
    default n
    help
      Enable the zlibs filter library.

      The library provides EMA, median, analog-filter, and debounce helpers.
      Debounce scheduling uses the shared internal zlibs workqueue.
```

## module/src/utils/lessdb/Kconfig
```kconfig
menuconfig ZLIBS_UTILS_LESSDB
    bool "LessDb"
    default n
    select ZLIBS_UTILS_MISC
    help
      Enable the lightweight embedded parameter database library.

      LessDb stores values using block/section/parameter indexing over a
      user-provided storage backend.
```

## module/src/utils/midi/Kconfig
```kconfig
menuconfig ZLIBS_UTILS_MIDI
    bool "MIDI library"
    default n
    help
      Enable the transport-agnostic MIDI parser/transmitter library.

      The module supports serial, BLE, and USB MIDI transport backends and
      provides message parsing, generation, and MIDI-thru routing helpers.

if ZLIBS_UTILS_MIDI

config ZLIBS_UTILS_MIDI_TRANSPORT_BLE
    bool "Build BLE MIDI transport"
    default y

config ZLIBS_UTILS_MIDI_TRANSPORT_SERIAL
    bool "Build serial MIDI transport"
    default y

config ZLIBS_UTILS_MIDI_TRANSPORT_USB
    bool "Build USB MIDI transport"
    default y

config ZLIBS_UTILS_MIDI_MAX_THRU_INTERFACES
    int "Maximum number of MIDI thru interfaces"
    default 5
    help
      Maximum number of interfaces that can be registered for MIDI-thru.

      Increase this if one MIDI input must forward traffic to more outputs.
      Higher values reserve additional memory for interface bookkeeping.

config ZLIBS_UTILS_MIDI_BLE_MAX_PACKET_SIZE
    int "Maximum number of bytes in BLE MIDI packet"
    default 64
    help
      Maximum encoded BLE-MIDI packet size, in bytes.

      Set this to the largest BLE packet your transport can produce or accept.
      Larger values improve headroom for bursts but increase temporary buffer
      usage.

endif
```

## module/src/utils/misc/Kconfig
```kconfig
menuconfig ZLIBS_UTILS_MISC
    bool "Misc utilities"
    default n
    help
      Enable various general-purpose utilities.

      This includes helpers such as ring buffers, numeric utilities, string
      helpers, mutex wrappers, and supporting templates used across zlibs.
```

## module/src/utils/motor_control/Kconfig
```kconfig
menuconfig ZLIBS_UTILS_MOTOR_CONTROL
    bool "Motor control"
    default n
    help
      Enable the zlibs motor-control library.

      This library coordinates one or more motors and schedules timer-driven
      movement updates. It also uses the shared internal workqueue for
      deferred cleanup outside interrupt context.
```

## module/src/utils/settings/Kconfig
```kconfig
menuconfig ZLIBS_UTILS_SETTINGS
    bool "Settings"
    default n
    select FLASH
    select FLASH_MAP
    select SETTINGS
    select ZMS
    help
      Enable the zlibs wrapper around the Zephyr settings subsystem.

      The library loads a typed settings subtree and persists updates through
      Zephyr settings backends. The Kconfig integration in this module assumes
      the ZMS-backed settings storage.
```

## module/src/utils/signaling/Kconfig
```kconfig
menuconfig ZLIBS_UTILS_SIGNALING
    bool "Signaling"
    select ZLIBS_UTILS_THREADS
    default n
    help
      Enable the asynchronous in-process publish/subscribe library.

      The signaling dispatcher runs callbacks from a dedicated thread and
      stores queued signals in a fixed-size memory slab.

if ZLIBS_UTILS_SIGNALING

config ZLIBS_UTILS_SIGNALING_MAX_PAYLOAD_LENGTH_BYTES
    int "Maximum signal payload size (bytes)"
    default 32
    help
      Maximum size, in bytes, of one published signal object stored in the
      dispatcher queue.

      Increase this if a signal type triggers the compile-time payload-size
      assertion.

config ZLIBS_UTILS_SIGNALING_MAX_POOL_SIZE
    int "Dispatch queue depth"
    default 32
    help
      Number of dispatch nodes preallocated for queued signals.

      This limits how many published signals can be pending at once and also
      determines the slab memory reserved by the dispatcher.

config ZLIBS_UTILS_SIGNALING_THREAD_PRIORITY
    int "Dispatcher thread priority"
    default 5
    help
      Zephyr priority used by the dedicated signaling dispatcher thread.

      Lower numeric values correspond to higher priority.

config ZLIBS_UTILS_SIGNALING_THREAD_STACK_SIZE
    int "Dispatcher thread stack size"
    default 2048
    help
      Stack size, in bytes, for the dedicated signaling dispatcher thread.

      Increase this if subscriber callbacks need more stack.

endif
```

## module/src/utils/state_machine/Kconfig
```kconfig
menuconfig ZLIBS_UTILS_STATE_MACHINE
    bool "State machine"
    default n
    help
      Enable the typed finite state-machine.

      This library provides compile-time checked state storage, event
      dispatch, and init/error-state handling.
```

## module/src/utils/sysex_conf/Kconfig
```kconfig
menuconfig ZLIBS_UTILS_SYSEX_CONF
    bool "SysEx configuration library"
    default n
    help
      Enable the SysEx-based configuration protocol library.

      The library supports GET/SET/BACKUP requests over a compile-time layout
      and optional custom requests handled by application callbacks.
```

## module/src/utils/threads/Kconfig
```kconfig
menuconfig ZLIBS_UTILS_THREADS
    bool "Threads"
    default n
    select THREADS
    help
      Enable zlibs wrappers around Zephyr threads and workqueues.

      This library provides the UserThread and WorkqueueThread templates used
      by other zlibs libraries.
```

## tests/src/drivers/uart_mock/testcase.yaml
```yaml
tests:
  uart_mock.test:
    build_only: false
    platform_allow: native_sim/native/64
    harness: gtest
    tags: drivers
```

## tests/src/utils/filters/testcase.yaml
```yaml
tests:
  filters.test:
    build_only: false
    platform_allow: native_sim/native/64
    harness: gtest
    tags: utils
```
