## module/src/utils/emueeprom/Kconfig
```kconfig
menuconfig ZLIBS_UTILS_EMUEEPROM
    bool "Emulated EEPROM"
    default n
    help
      Enable the flash-backed emulated EEPROM helper based on STM32
      application note AN3969.

      The module stores 16-bit values in two rotating flash pages and keeps a
      RAM mirror for fast reads and page transfers.
```
